## firmware/main/Kconfig.projbuild
```kconfig
menu "MavLTE"

    config BRIDGE_SERVER_HOST
        string "Relay server (host name or IP address)"
        default "relay.example.com"
        help
            The public server that runs "mavrelay.py server".

    config BRIDGE_SERVER_PORT
        int "Relay server UDP port"
        range 1 65535
        default 14650

    config BRIDGE_VEHICLE_KEY
        string "Vehicle key (64 hex characters)"
        default ""
        help
            The vehicle_key from the relay's /etc/mavrelay/mavrelay.ini.
            Create one with: python3 mavrelay.py genkey

    config BRIDGE_APN
        string "APN of the SIM card"
        default "internet"
        help
            Turkcell, Vodafone TR and Turk Telekom all use "internet".

    config BRIDGE_SIM_PIN
        string "SIM PIN (empty if the SIM has no PIN)"
        default ""

    choice BRIDGE_NETWORK_MODE
        prompt "Mobile network technology"
        default BRIDGE_NETWORK_AUTO

        config BRIDGE_NETWORK_AUTO
            bool "Automatic (LTE, falls back to 2G)"

        config BRIDGE_NETWORK_LTE_ONLY
            bool "LTE only"
            help
                2G is slow and draws the largest current peaks. LTE only avoids it, at the
                cost of no service where there is only 2G coverage.
    endchoice

    choice BRIDGE_BOARD
        prompt "Board version"
        default BRIDGE_BOARD_AUTO
        help
            V1 boards (sold until about December 2025) have an ESP32-S3R2; V2 boards have an
            ESP32-S3R8 and "VER 2.0" printed on the back. The firmware can tell them apart.

        config BRIDGE_BOARD_AUTO
            bool "Detect from the chip"
        config BRIDGE_BOARD_V1
            bool "V1 (ESP32-S3R2)"
        config BRIDGE_BOARD_V2
            bool "V2 (ESP32-S3R8)"
    endchoice

    config BRIDGE_FC_TX_GPIO
        int "GPIO: ESP32 TX, wire to the flight controller's RX (-1: board default)"
        range -1 48
        default -1
        help
            -1 picks a pin that is free on your board version: GPIO41 on V1, GPIO2 on V2.

    config BRIDGE_FC_RX_GPIO
        int "GPIO: ESP32 RX, wire to the flight controller's TX (-1: board default)"
        range -1 48
        default -1
        help
            -1 picks a pin that is free on your board version: GPIO42 on V1, GPIO3 on V2.

    config BRIDGE_FC_BAUD
        int "Flight controller baud rate"
        default 115200
        help
            Must match SERIALn_BAUD on the flight controller (115 means 115200).

    config BRIDGE_MODEM_BAUD
        int "Modem UART baud rate"
        default 921600
        help
            The modem starts at 115200 baud after power-up; the firmware then switches it to
            this rate (AT+IPR, not saved in the modem). PPP needs more than the flight
            controller's 115200 baud to keep up with it. Use 115200 to stay at the default.

    config BRIDGE_BATCH_MS
        int "Collect telemetry for this long before sending (ms)"
        range 0 500
        default 50
        help
            Fewer, larger packets use less mobile data: every packet costs 56 bytes of
            IP, UDP and tunnel headers. Adds up to this much delay to telemetry.
            Commands from the GCS to the aircraft are not delayed.

    config BRIDGE_ALWAYS_SEND
        bool "Send telemetry even when no GCS is connected"
        default n
        help
            By default telemetry is held back while no GCS is connected to the relay, which
            saves mobile data. The bridge keeps its session with the relay alive either way and
            resumes within about a second after a GCS connects.

    config BRIDGE_LOCATOR
        bool "Locator: the modem's own GNSS position, every few seconds"
        default y
        help
            The A7670E's GNSS (its antenna on the board's GNSS connector) reports where the aircraft
            is to the relay and MavLTE, whatever the flight controller does: after a crash too, as
            long as the board has power (an 18650 cell in its holder). The relay keeps the last known
            position. About 65 KB of mobile data an hour. Reading the GNSS during the data call needs
            the modem's multiplexer (CMUX); if the modem does not take it, the firmware goes on
            without it and still reports whether the flight controller talks.

    config BRIDGE_LOCATOR_INTERVAL
        int "Locator: seconds between position reports"
        depends on BRIDGE_LOCATOR
        range 2 300
        default 5

    config BRIDGE_LOCATOR_VOICE
        bool "Locator voice: the board's speaker, switched on and off in MavLTE"
        depends on BRIDGE_LOCATOR
        default y
        help
            MavLTE's Voice switch makes the speaker on the board's speaker header sound, again and
            again until the switch is off: for finding the aircraft in the last metres (tall grass,
            crops, bushes) once its position has brought you close. The relay keeps the switch, and
            the aircraft keeps sounding where it has no coverage. The modem plays it, commanded
            over its multiplexer (CMUX) like the GNSS.

    choice BRIDGE_LOCATOR_SOUND
        prompt "Locator voice: what the speaker plays"
        depends on BRIDGE_LOCATOR_VOICE
        default BRIDGE_LOCATOR_SOUND_ALARM

        config BRIDGE_LOCATOR_SOUND_ALARM
            bool "A two-tone alarm"
            help
                Beeps of 2.4 and 3 kHz in turn, where small speakers and ears are at their best and
                which is easy to walk towards. The firmware stores it in the modem's own flash once
                (a 32 KB file), and the modem plays it from there.

        config BRIDGE_LOCATOR_SOUND_PHRASE
            bool "A spoken phrase"
            help
                The modem's own text-to-speech says the phrase below every three seconds.
    endchoice

    config BRIDGE_LOCATOR_VOICE_TEXT
        string "Locator voice: the phrase"
        depends on BRIDGE_LOCATOR_SOUND_PHRASE
        default "Mav L T E here."
        help
            English. Letters with spaces between them are said one by one, so are digits: a phone
            number written "0 5 3 2 ..." tells whoever finds the aircraft whom to call. Quotes and
            characters other than ASCII are left out.

    config BRIDGE_SD_LOG
        bool "Flight log on the SD card (V2 boards)"
        default y
        help
            A CSV line a second on the SD card in the board's TF slot (MAVLTE/LOGnnnnn.CSV, a new file
            at each power-on): the module's GNSS, the mobile network and its signal, the relay link,
            the flight controller's telemetry and the board's power. The card must be FAT32. MavLTE
            downloads the files over the USB cable and over 4G. Without a card the firmware runs as
            before. V1 boards wire their TF slot differently and log nothing.

    config BRIDGE_CAMERA
        bool "Camera: a photo when MavLTE asks for one (Snapshot)"
        default y
        help
            The board's camera (OV5640; OV2640 on V1 boards) on its 24-pin connector, with DIP switch CAM on. It is
            started for each photo and stopped after it: between photos it takes no memory and
            no power, and it never takes a photo nobody asked for. Without a camera (or with this
            off) the aircraft answers that it has none.

    config BRIDGE_CAMERA_QUALITY
        int "Camera JPEG quality (lower: better and larger)"
        depends on BRIDGE_CAMERA
        range 4 63
        default 12
        help
            12 makes photos of about 5-10 KB at 320x240, 10-30 KB at 640x480 and 25-80 KB at
            1024x768, the upper end for bright, detailed scenes.

endmenu
```
